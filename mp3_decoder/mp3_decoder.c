/*
 * mp3_decoder.c - Contains functions to initialize the STA013
 * decoder chip and write/read to its registers.
 *
 * References: https://www.pjrc.com/mp3/sta013.html
 *
 * Code leverage: Except the values for the initialization, all
 * code was developed independently.
 *
 * Author: Ritika Ramchandani <rira3427@colorado.edu>
 *
 * Date: 12/01/2022
 *
 * Rev 1.0
 *
 */
#include "mp3_decoder.h"
#include "i2c.h"

#define INIT_ADDR (0x01) /* Initial address to check for STA013 detection */
#define MP3_DECODER_ADDR (0x86)
#define CONFIG_ARR_SIZE (4014)
#define PLL_ARR_SIZE (26)
#define SOFT_REBOOT_ADDR (0x10)
#define STA013_START_ADDR (0x72)
#define STA013_PLAY_ADDR (0x13)


/* Intial configuration values provided by ST */
__xdata uint8_t STA013_configData[CONFIG_ARR_SIZE] = {
0x3a, 0x01, 0x2a, 0x04, 0x28, 0x00, 0x29, 0x00, 0x20, 0x00, 0x21, 0x00, 0x22, 0x00, 0x23, 0x00, 0x24, 0x00, 0x25, 0x00,
0x26, 0x00, 0x27, 0x00, 0x28, 0x01, 0x28, 0x02, 0x21, 0x8f, 0x28, 0x03, 0x21, 0x00, 0x28, 0x04, 0x28, 0x05, 0x28, 0x06,
0x28, 0x07, 0x28, 0x08, 0x28, 0x09, 0x28, 0x0a, 0x28, 0x0b, 0x28, 0x0c, 0x20, 0x80, 0x21, 0x90, 0x28, 0x0d, 0x20, 0x00,
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0x08, 0x3a, 0x09, 0xbb, 0x50, 0x10, 0x52, 0x67, 0x51, 0x77, 0x05, 0xa1, 0x18, 0x04};


/* PLL initialization */
uint8_t PLL_init[PLL_ARR_SIZE] = {
0x54, 0x01, 0x55, 0x21, 0x07, 0x00, 0x06, 0x0C, 0x0B, 0x03,
0x50, 0x10, 0x51, 0x00, 0x52, 0x04, 0x61, 0x0F, 0x64, 0x55,
0x65, 0x55, 0x05, 0xA1, 0x18, 0x04};


/* Register read to STA013 */
unsigned char i2c_decoder_read(uint8_t addr)
{
    uint8_t rx_data = 0;
    i2c_start();
    send_byte(MP3_DECODER_ADDR);
    send_byte(addr);
    i2c_stop();
    i2c_start();
    send_byte(MP3_DECODER_ADDR | 0x1);

    rx_data = read_byte();

    /* Receiving ACK */
    SCL_Low;
    SDA_High; /* To accept input */
    delay_us(bitDelay);

    /* Wait until ACK is received */
    while(SDA);
    SCL_High;

    /* Toggle SCL to low */
    delay_us(bitDelay/2);
    SCL_Low;
    delay_us(bitDelay/2);

    i2c_stop();

    return rx_data;
}


/* Register write to STA013 */
void i2c_decoder_write(uint8_t addr, uint8_t wr_byte)
{
    i2c_start();
    send_byte(MP3_DECODER_ADDR);
    send_byte(addr);
    send_byte(wr_byte);
    i2c_stop();
}


/* Writing to internal STA013 Start register */
void i2c_decoder_start()
{
    i2c_decoder_write(STA013_START_ADDR, 1);
}


/* Writing to internal STA013 Play register */
void i2c_decoder_play()
{
    i2c_decoder_write(STA013_PLAY_ADDR, 1);
}


/* Sending all initialization data */
void decoder_init()
{
    uint8_t init_read = 0;

    /* Read from address 0x01 to check STA013 */
    init_read = i2c_decoder_read(INIT_ADDR);

    if(init_read != 0xAC) /*Indicate error */
        printf_tiny("ERROR: STA013 not initialized\n\r");

    /* Send 2007 writes from config */
    for(uint32_t i = 0; i < CONFIG_ARR_SIZE; i+=2)
    {
        i2c_decoder_write(STA013_configData[i], STA013_configData[i+1]);

        if(STA013_configData[i] == SOFT_REBOOT_ADDR)
            delay_us(1000000);
    }

    for(uint8_t i = 0; i < PLL_ARR_SIZE; i+=2)
    {
        i2c_decoder_write(PLL_init[i], PLL_init[i+1]);
    }
}
